## apps/system/mem_leak_checker/Kconfig
```kconfig
#
# For a description of the syntax of this configuration file,
# see kconfig-language at https://www.kernel.org/doc/Documentation/kbuild/kconfig-language.txt
#

config MEM_LEAK_CHECKER
	bool "Memory Leak Checker"
	default n
	depends on DEBUG_MM_HEAPINFO
	select SAVE_BIN_SECTION_ADDR if APP_BINARY_SEPARATION
	---help---
		Enable support for Memory Leak Checker. This requires arch/arm/src/<chip>/memory_region.h to work for the selected board.

if MEM_LEAK_CHECKER

config MEM_LEAK_CHECKER_HASH_TABLE_SIZE
	int "size of hash table"
	default 1007
	---help---
		The size of the hash table for searching. It is preferred to have this as a prime number

config MEM_LEAK_CHECKER_MAX_ALLOC_COUNT
	int "max allocation counts"
	default 3000
	---help---
		It must be larger than the total number of memory allocations.

endif

config MEM_CAPTURE
	bool "Memory Capture Utility"
	default n
	depends on DEBUG_MM_HEAPINFO
	---help---
		Enable memory capture utility with start/stop commands.
		Captures malloc/free for a specific PID and reports unfreed allocations.
		
		Commands:
		- mem_capture_start <pid>  : Start capturing for PID
		- mem_capture_stop  <pid>  : Stop and print unfreed allocations
```
